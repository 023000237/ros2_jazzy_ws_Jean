## esp32_ws/led/main/Kconfig.projbuild
```kconfig
menu "LED Configuration"

# Este proyecto es la variante SOLO LED (base de vision artificial). Para el
# TurtleBot completo (ruedas + LED) usa el proyecto hermano esp32_ws/chassis.

config LED_GPIO
    int "GPIO del LED de a bordo"
    default 2
    range 0 48
    help
        GPIO al que esta conectado el LED.
        En la mayoria de devkits ESP32 es el GPIO 2.

config LED_DEBUG_PRINT
    bool "Imprimir trazas de depuracion por UART"
    default n
    help
        Imprime por consola lo que llega en /set_led.

        DEJALO APAGADO en operacion normal: cuando el transporte de
        micro-ROS es UART0 (el default), la consola comparte el mismo
        puerto y estos mensajes se inyectan dentro del flujo XRCE-DDS,
        lo que puede provocar paquetes descartados.

        Enciendelo solo para depurar, de preferencia con el transporte
        UDP o moviendo la consola a otro UART.

config MICRO_ROS_APP_STACK
    int "Stack de la tarea micro-ROS (bytes)"
    default 16000
    help
        Tamano del stack en bytes de la tarea que corre micro-ROS.

config MICRO_ROS_APP_TASK_PRIO
    int "Prioridad de la tarea micro-ROS"
    default 5
    help
        Prioridad de la tarea de micro-ROS (mayor valor = mayor prioridad).

endmenu
```
